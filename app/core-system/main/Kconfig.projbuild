## app/core-system/main/Kconfig.projbuild
```kconfig
menu "Core System Configuration"

    config CORE_SYSTEM_WIFI_SSID
        string "WiFi SSID"
        default ""
        help
            接続先WiFiアクセスポイントのSSID。

    config CORE_SYSTEM_WIFI_PASSWORD
        string "WiFi Password"
        default ""
        help
            接続先WiFiアクセスポイントのパスワード。

    config CORE_SYSTEM_WEBSOCKET_URI
        string "WebSocket URI"
        default "ws://192.168.100.1:8080/ws"
        help
            接続先WebSocketサーバーのURI。
            末尾の /ws まで含めること (サーバーはこのパスでのみ受け付ける)。
            省略するとハンドシェイクが404で失敗する。

    config CORE_SYSTEM_DEVICE_ID
        string "Device ID (CoreID)"
        default "0000"
        help
            この個体のCoreID。トランシーバー経由の音声申告に使うため数字4桁で設定する。
            サーバーはこのIDでデバイスを識別する。

    config CORE_SYSTEM_BATTERY_MONITOR
        bool "Enable battery monitor"
        default y
        help
            バッテリー電圧監視を有効にする。

            30秒ごとに電圧を測定し、3.4Vを2回連続で下回ったら
            過放電保護のため Deep Sleep へ入る (docs/game_session_design.md §8.5)。
            測定値は device_status でサーバーへ報告し、マネージャー画面に出る。

            **USB給電やACアダプタで動かす場合は無効にすること。**
            バッテリーを繋がない構成では分圧回路の入力が不定になり、
            低電圧と誤判定して起動直後に Deep Sleep へ入ることがある。

            無効にすると測定・報告・Deep Sleep のすべてを行わない
            (マネージャー画面の電池欄は「—」になる)。

    config CORE_SYSTEM_BUZZER
        bool "Enable buzzer"
        default y
        help
            ブザーの鳴動を有効にする。

            ペナルティ通知・解除成功の短音と、Detonating 中の連続警告音を鳴らす
            (docs/game_session_design.md §4.1)。

            **開発中や深夜の動作確認では無効にすると静かに検証できる。**

            無効にすると GPIO を出力(LOW)に設定したまま一切駆動しない。
            鳴動パターンの進行はゲーム状態と独立しているため、
            有効・無効でゲーム進行やサーバーへの通知は変わらない。

endmenu
```

## app/core_system/main/Kconfig.projbuild
```kconfig
menu "Core System Configuration"

    config CORE_SYSTEM_WIFI_SSID
        string "WiFi SSID"
        default ""
        help
            接続先WiFiアクセスポイントのSSID。

    config CORE_SYSTEM_WIFI_PASSWORD
        string "WiFi Password"
        default ""
        help
            接続先WiFiアクセスポイントのパスワード。

    config CORE_SYSTEM_WEBSOCKET_URI
        string "WebSocket URI"
        default "ws://192.168.100.1:8080"
        help
            接続先WebSocketサーバーのURI。

    config CORE_SYSTEM_DEVICE_ID
        string "Device ID (CoreID)"
        default "0000"
        help
            この個体のCoreID。トランシーバー経由の音声申告に使うため数字4桁で設定する。
            サーバーはこのIDでデバイスを識別する。

endmenu
```
